## drivers/media/platform/imx/Kconfig
```kconfig
config MEDIA_IMX
	tristate "Multimedia Support for Freescale i.MX"
	depends on MEDIA_CONTROLLER
	---help---
	  This driver provides a SoC wide media controller device that all
	  multimedia components in i.MX5 and i.MX6 SoCs can register with.

config MEDIA_IMX_VIDEO_SWITCH
	tristate "i.MX Video Bus Multiplexer"
	depends on MEDIA_IMX && VIDEO_V4L2_SUBDEV_API
	help
	  This driver provides support for SoC internal video bus multiplexers
	  controlled by register bitfields as well as external multiplexers
	  controller by a GPIO.

config MEDIA_IMX_IPU_CSI
	tristate "i.MX5/6 CMOS Sensor Interface"
	depends on MEDIA_IMX && IMX_IPUV3_CORE && VIDEO_V4L2_SUBDEV_API
	select MEDIA_IMX_COMMON
	help
	  This is a v4l2 subdev driver for the CSI on i.MX5/6.

config MEDIA_IMX_COMMON
	tristate
```
